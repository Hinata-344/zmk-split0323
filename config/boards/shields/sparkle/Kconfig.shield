## config/boards/shields/sparkle/Kconfig.shield
```kconfig
# Copyright (c) 2020 Pete Johanson
# SPDX-License-Identifier: MIT

config SHIELD_SPARKLE_LEFT
    def_bool $(shields_list_contains,sparkle_left)

config SHIELD_SPARKLE_RIGHT
    def_bool $(shields_list_contains,sparkle_right)
```
